## Kconfig
```kconfig
menu "K-FSW platform"

config KFSW_STORAGE
	bool "K-FSW filesystem storage lifecycle"
	depends on FLASH_MAP
	depends on FILE_SYSTEM_LITTLEFS
	depends on FILE_SYSTEM_MKFS
	help
	  Enable the K-FSW LittleFS storage lifecycle over the fixed flash
	  partition selected by the kfsw,storage-partition devicetree chosen
	  property. File operations continue to use Zephyr's filesystem API.

config KFSW_WATCHDOG
	bool "K-FSW hardware watchdog"
	depends on WATCHDOG
	help
	  Enable the platform watchdog: arm the device selected by the
	  kfsw,watchdog chosen property, feed it, and stop feeding on request.
	  Without a kfsw,watchdog node every call returns -ENODEV.

config KFSW_WATCHDOG_TIMEOUT_MS
	int "Watchdog timeout in milliseconds"
	depends on KFSW_WATCHDOG
	default 8000
	range 100 32000
	help
	  Watchdog timeout. The keep-alive feeds at a third of this, so two
	  feeds can be missed before a reset.

config KFSW_WATCHDOG_AUTO_START
	bool "Arm the watchdog during application start-up"
	depends on KFSW_WATCHDOG
	default y
	help
	  Arm the watchdog once the application has started all services.
	  Turn this off to arm it later from the application.

endmenu

config KFSW_LASTWORDS
	bool "Leave a note before restarting"
	select CRC
	help
	  Keep a small record in RAM that start-up does not clear. It is
	  written before a restart and read by the boot service. It survives a
	  reset but not a power loss.

if KFSW_LASTWORDS

config KFSW_LASTWORDS_SUPPLY_WATCH
	bool "Watch the supply and leave a note when it dips"
	default y if SOC_SERIES_STM32L4X
	help
	  Arm the supply voltage detector so a note is written when the supply
	  drops. Whether the note survives depends on how far the voltage falls.

config KFSW_LASTWORDS_PVD_LEVEL
	hex "Detector threshold"
	default 0x60
	depends on KFSW_LASTWORDS_SUPPLY_WATCH && SOC_SERIES_STM32L4X
	help
	  Raw LL_PWR_PVDLEVEL_n value. Level 3 is about 2.5 V, above the
	  brown-out reset level.

endif # KFSW_LASTWORDS
```
